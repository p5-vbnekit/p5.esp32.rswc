## components/p5_rswc/Kconfig.projbuild
```kconfig
menu "p5_rwsc configuration"
    config P5_RWSC_GPIO_RANGE_MIN
        int
        default 0

    config P5_RWSC_GPIO_RANGE_MAX
        int
        default 33 if IDF_TARGET_ESP32
        default 46 if IDF_TARGET_ESP32S2
        default 19 if IDF_TARGET_ESP32C3
        default 48 if IDF_TARGET_ESP32S3

    config P5_RWSC_ENABLE_WIFI
        bool "Enable WiFi interface"
        default y
        help
            p5_rwsc can use Wi-Fi and/or Ethernet.
            Choose this option to enable WiFi.

    if P5_RWSC_ENABLE_WIFI
        config P5_RWSC_DEFAULT_WIFI_SSID_PREFIX
            string "Default WiFi SSID prefix"
            default "p5 esp32 rswc"
            help
                Default SSID (network name).

        config P5_RWSC_DEFAULT_WIFI_PASSWORD
            string "Default WiFi Password"
            default "12345678"
            help
                Default WiFi password (WPA or WPA2) to use.
                Can be left blank if the network has no security set.

        choice P5_RWSC_DEFAULT_WIFI_SCAN_METHOD
            prompt "Default WiFi Scan Method"
            default P5_RWSC_WIFI_SCAN_METHOD_ALL_CHANNEL
            help
                WiFi scan method:
                If "Fast" is selected, scan will end after find SSID match AP.
                If "All Channel" is selected, scan will end after scan all the channel.

            config P5_RWSC_WIFI_SCAN_METHOD_FAST
                bool "Fast"
            config P5_RWSC_WIFI_SCAN_METHOD_ALL_CHANNEL
                bool "All Channel"
        endchoice

        menu "WiFi Scan threshold"
            config P5_RWSC_DEFAULT_WIFI_SCAN_RSSI_THRESHOLD
                int "Default WiFi minimum rssi"
                range -127 0
                default -127
                help
                    The minimum rssi to accept in the scan mode.

            choice P5_RWSC_DEFAULT_WIFI_SCAN_AUTH_MODE_THRESHOLD
                prompt "Default WiFi Scan auth mode threshold"
                default P5_RWSC_WIFI_AUTH_OPEN
                help
                    The weakest authmode to accept in the scan mode.

                config P5_RWSC_WIFI_AUTH_OPEN
                    bool "OPEN"
                config P5_RWSC_WIFI_AUTH_WEP
                    bool "WEP"
                config P5_RWSC_WIFI_AUTH_WPA_PSK
                    bool "WPA PSK"
                config P5_RWSC_WIFI_AUTH_WPA2_PSK
                    bool "WPA2 PSK"
                config P5_RWSC_WIFI_AUTH_WPA_WPA2_PSK
                    bool "WPA WPA2 PSK"
                config P5_RWSC_WIFI_AUTH_WPA2_ENTERPRISE
                    bool "WPA2 ENTERPRISE"
                config P5_RWSC_WIFI_AUTH_WPA3_PSK
                    bool "WPA3 PSK"
                config P5_RWSC_WIFI_AUTH_WPA2_WPA3_PSK
                    bool "WPA2 WPA3 PSK"
                config P5_RWSC_WIFI_AUTH_WAPI_PSK
                    bool "WAPI PSK"
            endchoice
        endmenu
    endif # P5_RWSC_ENABLE_WIFI

    config P5_RWSC_ENABLE_ETHERNET
        bool "Enable Ethernet interface"
        default n
        help
            p5_rwsc can use Wi-Fi and/or Ethernet.
            Choose this option to enable Ethernet

    if P5_RWSC_ENABLE_ETHERNET
        config P5_RWSC_USE_SPI_ETHERNET
            bool

        choice P5_RWSC_ETHERNET_TYPE
            prompt "Ethernet Type"
            default P5_RWSC_USE_INTERNAL_ETHERNET if IDF_TARGET_ESP32
            default P5_RWSC_USE_W5500
            help
                Select which kind of Ethernet will be used.

            config P5_RWSC_USE_INTERNAL_ETHERNET
                depends on IDF_TARGET_ESP32
                select ETH_USE_ESP32_EMAC
                bool "Internal EMAC"
                help
                    Select internal Ethernet MAC controller.

            config P5_RWSC_USE_DM9051
                bool "DM9051 Module"
                select P5_RWSC_USE_SPI_ETHERNET
                select ETH_USE_SPI_ETHERNET
                select ETH_SPI_ETHERNET_DM9051
                help
                    Select external SPI-Ethernet module.

            config P5_RWSC_USE_W5500
                bool "W5500 Module"
                select P5_RWSC_USE_SPI_ETHERNET
                select ETH_USE_SPI_ETHERNET
                select ETH_SPI_ETHERNET_W5500
                help
                    Select external SPI-Ethernet module (W5500).

            config P5_RWSC_USE_OPENETH
                bool "OpenCores Ethernet MAC (EXPERIMENTAL)"
                select ETH_USE_OPENETH
                help
                    When this option is enabled, the firmware is built with support for
                    OpenCores Ethernet MAC, which allows testing the firmware in QEMU.
                    Note that this option is used for internal testing purposes, and
                    not officially supported. Firmware built with this option enabled
                    will not run on a real ESP32 chip.
        endchoice

        if P5_RWSC_USE_INTERNAL_ETHERNET
            choice P5_RWSC_ETH_PHY_MODEL
                prompt "Ethernet PHY Device"
                default P5_RWSC_ETH_PHY_IP101
                help
                    Select the Ethernet PHY device to use.

                config P5_RWSC_ETH_PHY_IP101
                    bool "IP101"
                    help
                        IP101 is a single port 10/100 MII/RMII/TP/Fiber Fast Ethernet Transceiver.
                        Goto http://www.icplus.com.tw/pp-IP101G.html for more information about it.

                config P5_RWSC_ETH_PHY_RTL8201
                    bool "RTL8201/SR8201"
                    help
                        RTL8201F/SR8201F is a single port 10/100Mb Ethernet Transceiver with auto MDIX.
                        Goto http://www.corechip-sz.com/productsview.asp?id=22 for more information about it.

                config P5_RWSC_ETH_PHY_LAN87XX
                    bool "LAN87xx"
                    help
                        Below chips are supported:
                        LAN8710A is a small footprint MII/RMII 10/100 Ethernet Transceiver with HP Auto-MDIX and
                            flexPWR® Technology.
                        LAN8720A is a small footprint RMII 10/100 Ethernet Transceiver with HP Auto-MDIX Support.
                        LAN8740A/LAN8741A is a small footprint MII/RMII 10/100 Energy Efficient Ethernet Transceiver
                            with HP Auto-MDIX and flexPWR® Technology.
                        LAN8742A is a small footprint RMII 10/100 Ethernet Transceiver with HP Auto-MDIX and
                            flexPWR® Technology.
                        Goto https://www.microchip.com for more information about them.

                config P5_RWSC_ETH_PHY_DP83848
                    bool "DP83848"
                    help
                        DP83848 is a single port 10/100Mb/s Ethernet Physical Layer Transceiver.
                        Goto http://www.ti.com/product/DP83848J for more information about it.
            endchoice

            config P5_RWSC_ETH_MDC_GPIO
                int "SMI MDC GPIO number"
                range P5_RWSC_GPIO_RANGE_MIN P5_RWSC_GPIO_RANGE_MAX
                default 23
                help
                    Set the GPIO number used by SMI MDC.

            config P5_RWSC_ETH_MDIO_GPIO
                int "SMI MDIO GPIO number"
                range P5_RWSC_GPIO_RANGE_MIN P5_RWSC_GPIO_RANGE_MAX
                default 18
                help
                    Set the GPIO number used by SMI MDIO.
        endif

        if P5_RWSC_USE_SPI_ETHERNET
            config P5_RWSC_ETH_SPI_HOST
                int "SPI Host Number"
                range 0 2
                default 1
                help
                    Set the SPI host used to communicate with the SPI Ethernet Controller.

            config P5_RWSC_ETH_SPI_SCLK_GPIO
                int "SPI SCLK GPIO number"
                range P5_RWSC_GPIO_RANGE_MIN P5_RWSC_GPIO_RANGE_MAX
                default 14
                help
                    Set the GPIO number used by SPI SCLK.

            config P5_RWSC_ETH_SPI_MOSI_GPIO
                int "SPI MOSI GPIO number"
                range P5_RWSC_GPIO_RANGE_MIN P5_RWSC_GPIO_RANGE_MAX
                default 13
                help
                    Set the GPIO number used by SPI MOSI.

            config P5_RWSC_ETH_SPI_MISO_GPIO
                int "SPI MISO GPIO number"
                range P5_RWSC_GPIO_RANGE_MIN P5_RWSC_GPIO_RANGE_MAX
                default 12
                help
                    Set the GPIO number used by SPI MISO.

            config P5_RWSC_ETH_SPI_CS_GPIO
                int "SPI CS GPIO number"
                range P5_RWSC_GPIO_RANGE_MIN P5_RWSC_GPIO_RANGE_MAX
                default 15
                help
                    Set the GPIO number used by SPI CS.

            config P5_RWSC_ETH_SPI_CLOCK_MHZ
                int "SPI clock speed (MHz)"
                range 5 80
                default 36
                help
                    Set the clock speed (MHz) of SPI interface.

            config P5_RWSC_ETH_SPI_INT_GPIO
                int "Interrupt GPIO number"
                range P5_RWSC_GPIO_RANGE_MIN P5_RWSC_GPIO_RANGE_MAX
                default 4
                help
                    Set the GPIO number used by the SPI Ethernet module interrupt line.
        endif # P5_RWSC_USE_SPI_ETHERNET

        config P5_RWSC_ETH_PHY_RST_GPIO
            int "PHY Reset GPIO number"
            range -1 P5_RWSC_GPIO_RANGE_MAX
            default 5
            help
                Set the GPIO number used to reset PHY chip.
                Set to -1 to disable PHY chip hardware reset.

        config P5_RWSC_ETH_PHY_ADDR
            int "PHY Address"
            range 0 31 if P5_RWSC_USE_INTERNAL_ETHERNET
            default 1
            help
                Set PHY address according your board schematic.
    endif # P5_RWSC_ENABLE_ETHERNET

    config P5_RWSC_ENABLE_IPV6
        bool "Obtain IPv6 address"
        default y
        depends on P5_RWSC_ENABLE_WIFI || P5_RWSC_ENABLE_ETHERNET
        select LWIP_IPV6
        help
            By default, firmware will wait until IPv4 and IPv6 local link addresses are obtained.
            Disable this option if the network does not support IPv6.
            Choose the preferred IPv6 address type if the connection code should wait until other than
            the local link address gets assigned.
            Consider enabling IPv6 stateless address autoconfiguration (SLAAC) in the LWIP component.

    if P5_RWSC_ENABLE_IPV6
        choice P5_RWSC_ENABLE_PREFERRED_IPV6
            prompt "Preferred IPv6 Type"
            default P5_RWSC_ENABLE_IPV6_PREF_LOCAL_LINK
            help
                Select which kind of IPv6 address the connect logic waits for.

            config P5_RWSC_ENABLE_IPV6_PREF_LOCAL_LINK
                bool "Local Link Address"
                help
                    Blocks until Local link address assigned.

            config P5_RWSC_ENABLE_IPV6_PREF_GLOBAL
                bool "Global Address"
                help
                    Blocks until Global address assigned.

            config P5_RWSC_ENABLE_IPV6_PREF_SITE_LOCAL
                bool "Site Local Address"
                help
                    Blocks until Site link address assigned.

            config P5_RWSC_ENABLE_IPV6_PREF_UNIQUE_LOCAL
                bool "Unique Local Link Address"
                help
                    Blocks until Unique local address assigned.
        endchoice
    endif # P5_RWSC_ENABLE_IPV6

    config P5_RWSC_VALID
        bool
        default y
        depends on P5_RWSC_ENABLE_WIFI || P5_RWSC_ENABLE_ETHERNET
        depends on CONFIG_COMPILER_CXX_RTTI
        depends on CONFIG_COMPILER_CXX_EXCEPTIONS
endmenu
```

## sdkconfig.defaults
```kconfig
CONFIG_COMPILER_CXX_RTTI=y
CONFIG_COMPILER_CXX_EXCEPTIONS=y

CONFIG_ESP_MAIN_TASK_STACK_SIZE=8192
CONFIG_ESP_SYSTEM_EVENT_TASK_STACK_SIZE=32768
```
